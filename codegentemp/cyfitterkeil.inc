#ifndef INCLUDED_CYFITTERKEIL_INC
#define INCLUDED_CYFITTERKEIL_INC
$INCLUDE (cydevicekeil.inc)
$INCLUDE (cydevicekeil_trm.inc)

; LCD_LCDPort
LCD_LCDPort__0__INTTYPE EQU CYREG_PICU2_INTTYPE0
LCD_LCDPort__0__MASK EQU 0x01
LCD_LCDPort__0__PC EQU CYREG_PRT2_PC0
LCD_LCDPort__0__PORT EQU 2
LCD_LCDPort__0__SHIFT EQU 0
LCD_LCDPort__1__INTTYPE EQU CYREG_PICU2_INTTYPE1
LCD_LCDPort__1__MASK EQU 0x02
LCD_LCDPort__1__PC EQU CYREG_PRT2_PC1
LCD_LCDPort__1__PORT EQU 2
LCD_LCDPort__1__SHIFT EQU 1
LCD_LCDPort__2__INTTYPE EQU CYREG_PICU2_INTTYPE2
LCD_LCDPort__2__MASK EQU 0x04
LCD_LCDPort__2__PC EQU CYREG_PRT2_PC2
LCD_LCDPort__2__PORT EQU 2
LCD_LCDPort__2__SHIFT EQU 2
LCD_LCDPort__3__INTTYPE EQU CYREG_PICU2_INTTYPE3
LCD_LCDPort__3__MASK EQU 0x08
LCD_LCDPort__3__PC EQU CYREG_PRT2_PC3
LCD_LCDPort__3__PORT EQU 2
LCD_LCDPort__3__SHIFT EQU 3
LCD_LCDPort__4__INTTYPE EQU CYREG_PICU2_INTTYPE4
LCD_LCDPort__4__MASK EQU 0x10
LCD_LCDPort__4__PC EQU CYREG_PRT2_PC4
LCD_LCDPort__4__PORT EQU 2
LCD_LCDPort__4__SHIFT EQU 4
LCD_LCDPort__5__INTTYPE EQU CYREG_PICU2_INTTYPE5
LCD_LCDPort__5__MASK EQU 0x20
LCD_LCDPort__5__PC EQU CYREG_PRT2_PC5
LCD_LCDPort__5__PORT EQU 2
LCD_LCDPort__5__SHIFT EQU 5
LCD_LCDPort__6__INTTYPE EQU CYREG_PICU2_INTTYPE6
LCD_LCDPort__6__MASK EQU 0x40
LCD_LCDPort__6__PC EQU CYREG_PRT2_PC6
LCD_LCDPort__6__PORT EQU 2
LCD_LCDPort__6__SHIFT EQU 6
LCD_LCDPort__AG EQU CYREG_PRT2_AG
LCD_LCDPort__AMUX EQU CYREG_PRT2_AMUX
LCD_LCDPort__BIE EQU CYREG_PRT2_BIE
LCD_LCDPort__BIT_MASK EQU CYREG_PRT2_BIT_MASK
LCD_LCDPort__BYP EQU CYREG_PRT2_BYP
LCD_LCDPort__CTL EQU CYREG_PRT2_CTL
LCD_LCDPort__DM0 EQU CYREG_PRT2_DM0
LCD_LCDPort__DM1 EQU CYREG_PRT2_DM1
LCD_LCDPort__DM2 EQU CYREG_PRT2_DM2
LCD_LCDPort__DR EQU CYREG_PRT2_DR
LCD_LCDPort__INP_DIS EQU CYREG_PRT2_INP_DIS
LCD_LCDPort__INTTYPE_BASE EQU CYDEV_PICU_INTTYPE_PICU2_BASE
LCD_LCDPort__LCD_COM_SEG EQU CYREG_PRT2_LCD_COM_SEG
LCD_LCDPort__LCD_EN EQU CYREG_PRT2_LCD_EN
LCD_LCDPort__MASK EQU 0x7F
LCD_LCDPort__PORT EQU 2
LCD_LCDPort__PRT EQU CYREG_PRT2_PRT
LCD_LCDPort__PRTDSI__CAPS_SEL EQU CYREG_PRT2_CAPS_SEL
LCD_LCDPort__PRTDSI__DBL_SYNC_IN EQU CYREG_PRT2_DBL_SYNC_IN
LCD_LCDPort__PRTDSI__OE_SEL0 EQU CYREG_PRT2_OE_SEL0
LCD_LCDPort__PRTDSI__OE_SEL1 EQU CYREG_PRT2_OE_SEL1
LCD_LCDPort__PRTDSI__OUT_SEL0 EQU CYREG_PRT2_OUT_SEL0
LCD_LCDPort__PRTDSI__OUT_SEL1 EQU CYREG_PRT2_OUT_SEL1
LCD_LCDPort__PRTDSI__SYNC_OUT EQU CYREG_PRT2_SYNC_OUT
LCD_LCDPort__PS EQU CYREG_PRT2_PS
LCD_LCDPort__SHIFT EQU 0
LCD_LCDPort__SLW EQU CYREG_PRT2_SLW

; LED
LED__0__INTTYPE EQU CYREG_PICU6_INTTYPE3
LED__0__MASK EQU 0x08
LED__0__PC EQU CYREG_PRT6_PC3
LED__0__PORT EQU 6
LED__0__SHIFT EQU 3
LED__AG EQU CYREG_PRT6_AG
LED__AMUX EQU CYREG_PRT6_AMUX
LED__BIE EQU CYREG_PRT6_BIE
LED__BIT_MASK EQU CYREG_PRT6_BIT_MASK
LED__BYP EQU CYREG_PRT6_BYP
LED__CTL EQU CYREG_PRT6_CTL
LED__DM0 EQU CYREG_PRT6_DM0
LED__DM1 EQU CYREG_PRT6_DM1
LED__DM2 EQU CYREG_PRT6_DM2
LED__DR EQU CYREG_PRT6_DR
LED__INP_DIS EQU CYREG_PRT6_INP_DIS
LED__INTTYPE_BASE EQU CYDEV_PICU_INTTYPE_PICU6_BASE
LED__LCD_COM_SEG EQU CYREG_PRT6_LCD_COM_SEG
LED__LCD_EN EQU CYREG_PRT6_LCD_EN
LED__MASK EQU 0x08
LED__PORT EQU 6
LED__PRT EQU CYREG_PRT6_PRT
LED__PRTDSI__CAPS_SEL EQU CYREG_PRT6_CAPS_SEL
LED__PRTDSI__DBL_SYNC_IN EQU CYREG_PRT6_DBL_SYNC_IN
LED__PRTDSI__OE_SEL0 EQU CYREG_PRT6_OE_SEL0
LED__PRTDSI__OE_SEL1 EQU CYREG_PRT6_OE_SEL1
LED__PRTDSI__OUT_SEL0 EQU CYREG_PRT6_OUT_SEL0
LED__PRTDSI__OUT_SEL1 EQU CYREG_PRT6_OUT_SEL1
LED__PRTDSI__SYNC_OUT EQU CYREG_PRT6_SYNC_OUT
LED__PS EQU CYREG_PRT6_PS
LED__SHIFT EQU 3
LED__SLW EQU CYREG_PRT6_SLW

; LED_Status
LED_Status__0__INTTYPE EQU CYREG_PICU6_INTTYPE2
LED_Status__0__MASK EQU 0x04
LED_Status__0__PC EQU CYREG_PRT6_PC2
LED_Status__0__PORT EQU 6
LED_Status__0__SHIFT EQU 2
LED_Status__AG EQU CYREG_PRT6_AG
LED_Status__AMUX EQU CYREG_PRT6_AMUX
LED_Status__BIE EQU CYREG_PRT6_BIE
LED_Status__BIT_MASK EQU CYREG_PRT6_BIT_MASK
LED_Status__BYP EQU CYREG_PRT6_BYP
LED_Status__CTL EQU CYREG_PRT6_CTL
LED_Status__DM0 EQU CYREG_PRT6_DM0
LED_Status__DM1 EQU CYREG_PRT6_DM1
LED_Status__DM2 EQU CYREG_PRT6_DM2
LED_Status__DR EQU CYREG_PRT6_DR
LED_Status__INP_DIS EQU CYREG_PRT6_INP_DIS
LED_Status__INTTYPE_BASE EQU CYDEV_PICU_INTTYPE_PICU6_BASE
LED_Status__LCD_COM_SEG EQU CYREG_PRT6_LCD_COM_SEG
LED_Status__LCD_EN EQU CYREG_PRT6_LCD_EN
LED_Status__MASK EQU 0x04
LED_Status__PORT EQU 6
LED_Status__PRT EQU CYREG_PRT6_PRT
LED_Status__PRTDSI__CAPS_SEL EQU CYREG_PRT6_CAPS_SEL
LED_Status__PRTDSI__DBL_SYNC_IN EQU CYREG_PRT6_DBL_SYNC_IN
LED_Status__PRTDSI__OE_SEL0 EQU CYREG_PRT6_OE_SEL0
LED_Status__PRTDSI__OE_SEL1 EQU CYREG_PRT6_OE_SEL1
LED_Status__PRTDSI__OUT_SEL0 EQU CYREG_PRT6_OUT_SEL0
LED_Status__PRTDSI__OUT_SEL1 EQU CYREG_PRT6_OUT_SEL1
LED_Status__PRTDSI__SYNC_OUT EQU CYREG_PRT6_SYNC_OUT
LED_Status__PS EQU CYREG_PRT6_PS
LED_Status__SHIFT EQU 2
LED_Status__SLW EQU CYREG_PRT6_SLW

; Pin_1
Pin_1__0__INTTYPE EQU CYREG_PICU5_INTTYPE3
Pin_1__0__MASK EQU 0x08
Pin_1__0__PC EQU CYREG_PRT5_PC3
Pin_1__0__PORT EQU 5
Pin_1__0__SHIFT EQU 3
Pin_1__AG EQU CYREG_PRT5_AG
Pin_1__AMUX EQU CYREG_PRT5_AMUX
Pin_1__BIE EQU CYREG_PRT5_BIE
Pin_1__BIT_MASK EQU CYREG_PRT5_BIT_MASK
Pin_1__BYP EQU CYREG_PRT5_BYP
Pin_1__CTL EQU CYREG_PRT5_CTL
Pin_1__DM0 EQU CYREG_PRT5_DM0
Pin_1__DM1 EQU CYREG_PRT5_DM1
Pin_1__DM2 EQU CYREG_PRT5_DM2
Pin_1__DR EQU CYREG_PRT5_DR
Pin_1__INP_DIS EQU CYREG_PRT5_INP_DIS
Pin_1__INTTYPE_BASE EQU CYDEV_PICU_INTTYPE_PICU5_BASE
Pin_1__LCD_COM_SEG EQU CYREG_PRT5_LCD_COM_SEG
Pin_1__LCD_EN EQU CYREG_PRT5_LCD_EN
Pin_1__MASK EQU 0x08
Pin_1__PORT EQU 5
Pin_1__PRT EQU CYREG_PRT5_PRT
Pin_1__PRTDSI__CAPS_SEL EQU CYREG_PRT5_CAPS_SEL
Pin_1__PRTDSI__DBL_SYNC_IN EQU CYREG_PRT5_DBL_SYNC_IN
Pin_1__PRTDSI__OE_SEL0 EQU CYREG_PRT5_OE_SEL0
Pin_1__PRTDSI__OE_SEL1 EQU CYREG_PRT5_OE_SEL1
Pin_1__PRTDSI__OUT_SEL0 EQU CYREG_PRT5_OUT_SEL0
Pin_1__PRTDSI__OUT_SEL1 EQU CYREG_PRT5_OUT_SEL1
Pin_1__PRTDSI__SYNC_OUT EQU CYREG_PRT5_SYNC_OUT
Pin_1__PS EQU CYREG_PRT5_PS
Pin_1__SHIFT EQU 3
Pin_1__SLW EQU CYREG_PRT5_SLW

; SyncOut
SyncOut__0__INTTYPE EQU CYREG_PICU5_INTTYPE2
SyncOut__0__MASK EQU 0x04
SyncOut__0__PC EQU CYREG_PRT5_PC2
SyncOut__0__PORT EQU 5
SyncOut__0__SHIFT EQU 2
SyncOut__AG EQU CYREG_PRT5_AG
SyncOut__AMUX EQU CYREG_PRT5_AMUX
SyncOut__BIE EQU CYREG_PRT5_BIE
SyncOut__BIT_MASK EQU CYREG_PRT5_BIT_MASK
SyncOut__BYP EQU CYREG_PRT5_BYP
SyncOut__CTL EQU CYREG_PRT5_CTL
SyncOut__DM0 EQU CYREG_PRT5_DM0
SyncOut__DM1 EQU CYREG_PRT5_DM1
SyncOut__DM2 EQU CYREG_PRT5_DM2
SyncOut__DR EQU CYREG_PRT5_DR
SyncOut__INP_DIS EQU CYREG_PRT5_INP_DIS
SyncOut__INTTYPE_BASE EQU CYDEV_PICU_INTTYPE_PICU5_BASE
SyncOut__LCD_COM_SEG EQU CYREG_PRT5_LCD_COM_SEG
SyncOut__LCD_EN EQU CYREG_PRT5_LCD_EN
SyncOut__MASK EQU 0x04
SyncOut__PORT EQU 5
SyncOut__PRT EQU CYREG_PRT5_PRT
SyncOut__PRTDSI__CAPS_SEL EQU CYREG_PRT5_CAPS_SEL
SyncOut__PRTDSI__DBL_SYNC_IN EQU CYREG_PRT5_DBL_SYNC_IN
SyncOut__PRTDSI__OE_SEL0 EQU CYREG_PRT5_OE_SEL0
SyncOut__PRTDSI__OE_SEL1 EQU CYREG_PRT5_OE_SEL1
SyncOut__PRTDSI__OUT_SEL0 EQU CYREG_PRT5_OUT_SEL0
SyncOut__PRTDSI__OUT_SEL1 EQU CYREG_PRT5_OUT_SEL1
SyncOut__PRTDSI__SYNC_OUT EQU CYREG_PRT5_SYNC_OUT
SyncOut__PS EQU CYREG_PRT5_PS
SyncOut__SHIFT EQU 2
SyncOut__SLW EQU CYREG_PRT5_SLW

; deBounce
deBounce__CFG0 EQU CYREG_CLKDIST_DCFG1_CFG0
deBounce__CFG1 EQU CYREG_CLKDIST_DCFG1_CFG1
deBounce__CFG2 EQU CYREG_CLKDIST_DCFG1_CFG2
deBounce__CFG2_SRC_SEL_MASK EQU 0x07
deBounce__INDEX EQU 0x01
deBounce__PM_ACT_CFG EQU CYREG_PM_ACT_CFG2
deBounce__PM_ACT_MSK EQU 0x02
deBounce__PM_STBY_CFG EQU CYREG_PM_STBY_CFG2
deBounce__PM_STBY_MSK EQU 0x02

; PWM_clock
PWM_clock__CFG0 EQU CYREG_CLKDIST_DCFG0_CFG0
PWM_clock__CFG1 EQU CYREG_CLKDIST_DCFG0_CFG1
PWM_clock__CFG2 EQU CYREG_CLKDIST_DCFG0_CFG2
PWM_clock__CFG2_SRC_SEL_MASK EQU 0x07
PWM_clock__INDEX EQU 0x00
PWM_clock__PM_ACT_CFG EQU CYREG_PM_ACT_CFG2
PWM_clock__PM_ACT_MSK EQU 0x01
PWM_clock__PM_STBY_CFG EQU CYREG_PM_STBY_CFG2
PWM_clock__PM_STBY_MSK EQU 0x01

; pushButton
pushButton__0__INTTYPE EQU CYREG_PICU6_INTTYPE1
pushButton__0__MASK EQU 0x02
pushButton__0__PC EQU CYREG_PRT6_PC1
pushButton__0__PORT EQU 6
pushButton__0__SHIFT EQU 1
pushButton__AG EQU CYREG_PRT6_AG
pushButton__AMUX EQU CYREG_PRT6_AMUX
pushButton__BIE EQU CYREG_PRT6_BIE
pushButton__BIT_MASK EQU CYREG_PRT6_BIT_MASK
pushButton__BYP EQU CYREG_PRT6_BYP
pushButton__CTL EQU CYREG_PRT6_CTL
pushButton__DM0 EQU CYREG_PRT6_DM0
pushButton__DM1 EQU CYREG_PRT6_DM1
pushButton__DM2 EQU CYREG_PRT6_DM2
pushButton__DR EQU CYREG_PRT6_DR
pushButton__INP_DIS EQU CYREG_PRT6_INP_DIS
pushButton__INTTYPE_BASE EQU CYDEV_PICU_INTTYPE_PICU6_BASE
pushButton__LCD_COM_SEG EQU CYREG_PRT6_LCD_COM_SEG
pushButton__LCD_EN EQU CYREG_PRT6_LCD_EN
pushButton__MASK EQU 0x02
pushButton__PORT EQU 6
pushButton__PRT EQU CYREG_PRT6_PRT
pushButton__PRTDSI__CAPS_SEL EQU CYREG_PRT6_CAPS_SEL
pushButton__PRTDSI__DBL_SYNC_IN EQU CYREG_PRT6_DBL_SYNC_IN
pushButton__PRTDSI__OE_SEL0 EQU CYREG_PRT6_OE_SEL0
pushButton__PRTDSI__OE_SEL1 EQU CYREG_PRT6_OE_SEL1
pushButton__PRTDSI__OUT_SEL0 EQU CYREG_PRT6_OUT_SEL0
pushButton__PRTDSI__OUT_SEL1 EQU CYREG_PRT6_OUT_SEL1
pushButton__PRTDSI__SYNC_OUT EQU CYREG_PRT6_SYNC_OUT
pushButton__PS EQU CYREG_PRT6_PS
pushButton__SHIFT EQU 1
pushButton__SLW EQU CYREG_PRT6_SLW

; MOSFET_Gate
MOSFET_Gate__0__INTTYPE EQU CYREG_PICU5_INTTYPE4
MOSFET_Gate__0__MASK EQU 0x10
MOSFET_Gate__0__PC EQU CYREG_PRT5_PC4
MOSFET_Gate__0__PORT EQU 5
MOSFET_Gate__0__SHIFT EQU 4
MOSFET_Gate__AG EQU CYREG_PRT5_AG
MOSFET_Gate__AMUX EQU CYREG_PRT5_AMUX
MOSFET_Gate__BIE EQU CYREG_PRT5_BIE
MOSFET_Gate__BIT_MASK EQU CYREG_PRT5_BIT_MASK
MOSFET_Gate__BYP EQU CYREG_PRT5_BYP
MOSFET_Gate__CTL EQU CYREG_PRT5_CTL
MOSFET_Gate__DM0 EQU CYREG_PRT5_DM0
MOSFET_Gate__DM1 EQU CYREG_PRT5_DM1
MOSFET_Gate__DM2 EQU CYREG_PRT5_DM2
MOSFET_Gate__DR EQU CYREG_PRT5_DR
MOSFET_Gate__INP_DIS EQU CYREG_PRT5_INP_DIS
MOSFET_Gate__INTTYPE_BASE EQU CYDEV_PICU_INTTYPE_PICU5_BASE
MOSFET_Gate__LCD_COM_SEG EQU CYREG_PRT5_LCD_COM_SEG
MOSFET_Gate__LCD_EN EQU CYREG_PRT5_LCD_EN
MOSFET_Gate__MASK EQU 0x10
MOSFET_Gate__PORT EQU 5
MOSFET_Gate__PRT EQU CYREG_PRT5_PRT
MOSFET_Gate__PRTDSI__CAPS_SEL EQU CYREG_PRT5_CAPS_SEL
MOSFET_Gate__PRTDSI__DBL_SYNC_IN EQU CYREG_PRT5_DBL_SYNC_IN
MOSFET_Gate__PRTDSI__OE_SEL0 EQU CYREG_PRT5_OE_SEL0
MOSFET_Gate__PRTDSI__OE_SEL1 EQU CYREG_PRT5_OE_SEL1
MOSFET_Gate__PRTDSI__OUT_SEL0 EQU CYREG_PRT5_OUT_SEL0
MOSFET_Gate__PRTDSI__OUT_SEL1 EQU CYREG_PRT5_OUT_SEL1
MOSFET_Gate__PRTDSI__SYNC_OUT EQU CYREG_PRT5_SYNC_OUT
MOSFET_Gate__PS EQU CYREG_PRT5_PS
MOSFET_Gate__SHIFT EQU 4
MOSFET_Gate__SLW EQU CYREG_PRT5_SLW

; hallTickTimer_TimerUDB
hallTickTimer_TimerUDB_rstSts_stsreg__0__MASK EQU 0x01
hallTickTimer_TimerUDB_rstSts_stsreg__0__POS EQU 0
hallTickTimer_TimerUDB_rstSts_stsreg__1__MASK EQU 0x02
hallTickTimer_TimerUDB_rstSts_stsreg__1__POS EQU 1
hallTickTimer_TimerUDB_rstSts_stsreg__16BIT_STATUS_AUX_CTL_REG EQU CYREG_B1_UDB04_05_ACTL
hallTickTimer_TimerUDB_rstSts_stsreg__16BIT_STATUS_REG EQU CYREG_B1_UDB04_05_ST
hallTickTimer_TimerUDB_rstSts_stsreg__2__MASK EQU 0x04
hallTickTimer_TimerUDB_rstSts_stsreg__2__POS EQU 2
hallTickTimer_TimerUDB_rstSts_stsreg__3__MASK EQU 0x08
hallTickTimer_TimerUDB_rstSts_stsreg__3__POS EQU 3
hallTickTimer_TimerUDB_rstSts_stsreg__MASK EQU 0x0F
hallTickTimer_TimerUDB_rstSts_stsreg__MASK_REG EQU CYREG_B1_UDB04_MSK
hallTickTimer_TimerUDB_rstSts_stsreg__STATUS_AUX_CTL_REG EQU CYREG_B1_UDB04_ACTL
hallTickTimer_TimerUDB_rstSts_stsreg__STATUS_REG EQU CYREG_B1_UDB04_ST
hallTickTimer_TimerUDB_sCTRLReg_SyncCtl_ctrlreg__16BIT_CONTROL_AUX_CTL_REG EQU CYREG_B1_UDB05_06_ACTL
hallTickTimer_TimerUDB_sCTRLReg_SyncCtl_ctrlreg__16BIT_CONTROL_CONTROL_REG EQU CYREG_B1_UDB05_06_CTL
hallTickTimer_TimerUDB_sCTRLReg_SyncCtl_ctrlreg__16BIT_CONTROL_COUNT_REG EQU CYREG_B1_UDB05_06_CTL
hallTickTimer_TimerUDB_sCTRLReg_SyncCtl_ctrlreg__16BIT_COUNT_CONTROL_REG EQU CYREG_B1_UDB05_06_CTL
hallTickTimer_TimerUDB_sCTRLReg_SyncCtl_ctrlreg__16BIT_COUNT_COUNT_REG EQU CYREG_B1_UDB05_06_CTL
hallTickTimer_TimerUDB_sCTRLReg_SyncCtl_ctrlreg__16BIT_MASK_MASK_REG EQU CYREG_B1_UDB05_06_MSK
hallTickTimer_TimerUDB_sCTRLReg_SyncCtl_ctrlreg__16BIT_MASK_PERIOD_REG EQU CYREG_B1_UDB05_06_MSK
hallTickTimer_TimerUDB_sCTRLReg_SyncCtl_ctrlreg__16BIT_PERIOD_MASK_REG EQU CYREG_B1_UDB05_06_MSK
hallTickTimer_TimerUDB_sCTRLReg_SyncCtl_ctrlreg__16BIT_PERIOD_PERIOD_REG EQU CYREG_B1_UDB05_06_MSK
hallTickTimer_TimerUDB_sCTRLReg_SyncCtl_ctrlreg__7__MASK EQU 0x80
hallTickTimer_TimerUDB_sCTRLReg_SyncCtl_ctrlreg__7__POS EQU 7
hallTickTimer_TimerUDB_sCTRLReg_SyncCtl_ctrlreg__CONTROL_AUX_CTL_REG EQU CYREG_B1_UDB05_ACTL
hallTickTimer_TimerUDB_sCTRLReg_SyncCtl_ctrlreg__CONTROL_REG EQU CYREG_B1_UDB05_CTL
hallTickTimer_TimerUDB_sCTRLReg_SyncCtl_ctrlreg__CONTROL_ST_REG EQU CYREG_B1_UDB05_ST_CTL
hallTickTimer_TimerUDB_sCTRLReg_SyncCtl_ctrlreg__COUNT_REG EQU CYREG_B1_UDB05_CTL
hallTickTimer_TimerUDB_sCTRLReg_SyncCtl_ctrlreg__COUNT_ST_REG EQU CYREG_B1_UDB05_ST_CTL
hallTickTimer_TimerUDB_sCTRLReg_SyncCtl_ctrlreg__MASK EQU 0x80
hallTickTimer_TimerUDB_sCTRLReg_SyncCtl_ctrlreg__MASK_CTL_AUX_CTL_REG EQU CYREG_B1_UDB05_MSK_ACTL
hallTickTimer_TimerUDB_sCTRLReg_SyncCtl_ctrlreg__PER_CTL_AUX_CTL_REG EQU CYREG_B1_UDB05_MSK_ACTL
hallTickTimer_TimerUDB_sCTRLReg_SyncCtl_ctrlreg__PERIOD_REG EQU CYREG_B1_UDB05_MSK
hallTickTimer_TimerUDB_sT32_timerdp_u0__16BIT_A0_REG EQU CYREG_B1_UDB04_05_A0
hallTickTimer_TimerUDB_sT32_timerdp_u0__16BIT_A1_REG EQU CYREG_B1_UDB04_05_A1
hallTickTimer_TimerUDB_sT32_timerdp_u0__16BIT_D0_REG EQU CYREG_B1_UDB04_05_D0
hallTickTimer_TimerUDB_sT32_timerdp_u0__16BIT_D1_REG EQU CYREG_B1_UDB04_05_D1
hallTickTimer_TimerUDB_sT32_timerdp_u0__16BIT_DP_AUX_CTL_REG EQU CYREG_B1_UDB04_05_ACTL
hallTickTimer_TimerUDB_sT32_timerdp_u0__16BIT_F0_REG EQU CYREG_B1_UDB04_05_F0
hallTickTimer_TimerUDB_sT32_timerdp_u0__16BIT_F1_REG EQU CYREG_B1_UDB04_05_F1
hallTickTimer_TimerUDB_sT32_timerdp_u0__A0_A1_REG EQU CYREG_B1_UDB04_A0_A1
hallTickTimer_TimerUDB_sT32_timerdp_u0__A0_REG EQU CYREG_B1_UDB04_A0
hallTickTimer_TimerUDB_sT32_timerdp_u0__A1_REG EQU CYREG_B1_UDB04_A1
hallTickTimer_TimerUDB_sT32_timerdp_u0__D0_D1_REG EQU CYREG_B1_UDB04_D0_D1
hallTickTimer_TimerUDB_sT32_timerdp_u0__D0_REG EQU CYREG_B1_UDB04_D0
hallTickTimer_TimerUDB_sT32_timerdp_u0__D1_REG EQU CYREG_B1_UDB04_D1
hallTickTimer_TimerUDB_sT32_timerdp_u0__DP_AUX_CTL_REG EQU CYREG_B1_UDB04_ACTL
hallTickTimer_TimerUDB_sT32_timerdp_u0__F0_F1_REG EQU CYREG_B1_UDB04_F0_F1
hallTickTimer_TimerUDB_sT32_timerdp_u0__F0_REG EQU CYREG_B1_UDB04_F0
hallTickTimer_TimerUDB_sT32_timerdp_u0__F1_REG EQU CYREG_B1_UDB04_F1
hallTickTimer_TimerUDB_sT32_timerdp_u1__16BIT_A0_REG EQU CYREG_B1_UDB05_06_A0
hallTickTimer_TimerUDB_sT32_timerdp_u1__16BIT_A1_REG EQU CYREG_B1_UDB05_06_A1
hallTickTimer_TimerUDB_sT32_timerdp_u1__16BIT_D0_REG EQU CYREG_B1_UDB05_06_D0
hallTickTimer_TimerUDB_sT32_timerdp_u1__16BIT_D1_REG EQU CYREG_B1_UDB05_06_D1
hallTickTimer_TimerUDB_sT32_timerdp_u1__16BIT_DP_AUX_CTL_REG EQU CYREG_B1_UDB05_06_ACTL
hallTickTimer_TimerUDB_sT32_timerdp_u1__16BIT_F0_REG EQU CYREG_B1_UDB05_06_F0
hallTickTimer_TimerUDB_sT32_timerdp_u1__16BIT_F1_REG EQU CYREG_B1_UDB05_06_F1
hallTickTimer_TimerUDB_sT32_timerdp_u1__A0_A1_REG EQU CYREG_B1_UDB05_A0_A1
hallTickTimer_TimerUDB_sT32_timerdp_u1__A0_REG EQU CYREG_B1_UDB05_A0
hallTickTimer_TimerUDB_sT32_timerdp_u1__A1_REG EQU CYREG_B1_UDB05_A1
hallTickTimer_TimerUDB_sT32_timerdp_u1__D0_D1_REG EQU CYREG_B1_UDB05_D0_D1
hallTickTimer_TimerUDB_sT32_timerdp_u1__D0_REG EQU CYREG_B1_UDB05_D0
hallTickTimer_TimerUDB_sT32_timerdp_u1__D1_REG EQU CYREG_B1_UDB05_D1
hallTickTimer_TimerUDB_sT32_timerdp_u1__DP_AUX_CTL_REG EQU CYREG_B1_UDB05_ACTL
hallTickTimer_TimerUDB_sT32_timerdp_u1__F0_F1_REG EQU CYREG_B1_UDB05_F0_F1
hallTickTimer_TimerUDB_sT32_timerdp_u1__F0_REG EQU CYREG_B1_UDB05_F0
hallTickTimer_TimerUDB_sT32_timerdp_u1__F1_REG EQU CYREG_B1_UDB05_F1
hallTickTimer_TimerUDB_sT32_timerdp_u1__MSK_DP_AUX_CTL_REG EQU CYREG_B1_UDB05_MSK_ACTL
hallTickTimer_TimerUDB_sT32_timerdp_u1__PER_DP_AUX_CTL_REG EQU CYREG_B1_UDB05_MSK_ACTL
hallTickTimer_TimerUDB_sT32_timerdp_u2__16BIT_A0_REG EQU CYREG_B1_UDB06_07_A0
hallTickTimer_TimerUDB_sT32_timerdp_u2__16BIT_A1_REG EQU CYREG_B1_UDB06_07_A1
hallTickTimer_TimerUDB_sT32_timerdp_u2__16BIT_D0_REG EQU CYREG_B1_UDB06_07_D0
hallTickTimer_TimerUDB_sT32_timerdp_u2__16BIT_D1_REG EQU CYREG_B1_UDB06_07_D1
hallTickTimer_TimerUDB_sT32_timerdp_u2__16BIT_DP_AUX_CTL_REG EQU CYREG_B1_UDB06_07_ACTL
hallTickTimer_TimerUDB_sT32_timerdp_u2__16BIT_F0_REG EQU CYREG_B1_UDB06_07_F0
hallTickTimer_TimerUDB_sT32_timerdp_u2__16BIT_F1_REG EQU CYREG_B1_UDB06_07_F1
hallTickTimer_TimerUDB_sT32_timerdp_u2__A0_A1_REG EQU CYREG_B1_UDB06_A0_A1
hallTickTimer_TimerUDB_sT32_timerdp_u2__A0_REG EQU CYREG_B1_UDB06_A0
hallTickTimer_TimerUDB_sT32_timerdp_u2__A1_REG EQU CYREG_B1_UDB06_A1
hallTickTimer_TimerUDB_sT32_timerdp_u2__D0_D1_REG EQU CYREG_B1_UDB06_D0_D1
hallTickTimer_TimerUDB_sT32_timerdp_u2__D0_REG EQU CYREG_B1_UDB06_D0
hallTickTimer_TimerUDB_sT32_timerdp_u2__D1_REG EQU CYREG_B1_UDB06_D1
hallTickTimer_TimerUDB_sT32_timerdp_u2__DP_AUX_CTL_REG EQU CYREG_B1_UDB06_ACTL
hallTickTimer_TimerUDB_sT32_timerdp_u2__F0_F1_REG EQU CYREG_B1_UDB06_F0_F1
hallTickTimer_TimerUDB_sT32_timerdp_u2__F0_REG EQU CYREG_B1_UDB06_F0
hallTickTimer_TimerUDB_sT32_timerdp_u2__F1_REG EQU CYREG_B1_UDB06_F1
hallTickTimer_TimerUDB_sT32_timerdp_u3__16BIT_A0_REG EQU CYREG_B1_UDB07_08_A0
hallTickTimer_TimerUDB_sT32_timerdp_u3__16BIT_A1_REG EQU CYREG_B1_UDB07_08_A1
hallTickTimer_TimerUDB_sT32_timerdp_u3__16BIT_D0_REG EQU CYREG_B1_UDB07_08_D0
hallTickTimer_TimerUDB_sT32_timerdp_u3__16BIT_D1_REG EQU CYREG_B1_UDB07_08_D1
hallTickTimer_TimerUDB_sT32_timerdp_u3__16BIT_DP_AUX_CTL_REG EQU CYREG_B1_UDB07_08_ACTL
hallTickTimer_TimerUDB_sT32_timerdp_u3__16BIT_F0_REG EQU CYREG_B1_UDB07_08_F0
hallTickTimer_TimerUDB_sT32_timerdp_u3__16BIT_F1_REG EQU CYREG_B1_UDB07_08_F1
hallTickTimer_TimerUDB_sT32_timerdp_u3__A0_A1_REG EQU CYREG_B1_UDB07_A0_A1
hallTickTimer_TimerUDB_sT32_timerdp_u3__A0_REG EQU CYREG_B1_UDB07_A0
hallTickTimer_TimerUDB_sT32_timerdp_u3__A1_REG EQU CYREG_B1_UDB07_A1
hallTickTimer_TimerUDB_sT32_timerdp_u3__D0_D1_REG EQU CYREG_B1_UDB07_D0_D1
hallTickTimer_TimerUDB_sT32_timerdp_u3__D0_REG EQU CYREG_B1_UDB07_D0
hallTickTimer_TimerUDB_sT32_timerdp_u3__D1_REG EQU CYREG_B1_UDB07_D1
hallTickTimer_TimerUDB_sT32_timerdp_u3__DP_AUX_CTL_REG EQU CYREG_B1_UDB07_ACTL
hallTickTimer_TimerUDB_sT32_timerdp_u3__F0_F1_REG EQU CYREG_B1_UDB07_F0_F1
hallTickTimer_TimerUDB_sT32_timerdp_u3__F0_REG EQU CYREG_B1_UDB07_F0
hallTickTimer_TimerUDB_sT32_timerdp_u3__F1_REG EQU CYREG_B1_UDB07_F1
hallTickTimer_TimerUDB_sT32_timerdp_u3__MSK_DP_AUX_CTL_REG EQU CYREG_B1_UDB07_MSK_ACTL
hallTickTimer_TimerUDB_sT32_timerdp_u3__PER_DP_AUX_CTL_REG EQU CYREG_B1_UDB07_MSK_ACTL

; hallEffect_ISR
hallEffect_ISR__ES2_PATCH EQU 0
hallEffect_ISR__INTC_CLR_EN_REG EQU CYREG_INTC_CLR_EN0
hallEffect_ISR__INTC_CLR_PD_REG EQU CYREG_INTC_CLR_PD0
hallEffect_ISR__INTC_MASK EQU 0x01
hallEffect_ISR__INTC_NUMBER EQU 0
hallEffect_ISR__INTC_PRIOR_NUM EQU 7
hallEffect_ISR__INTC_PRIOR_REG EQU CYREG_INTC_PRIOR0
hallEffect_ISR__INTC_SET_EN_REG EQU CYREG_INTC_SET_EN0
hallEffect_ISR__INTC_SET_PD_REG EQU CYREG_INTC_SET_PD0
hallEffect_ISR__INTC_VECT EQU (CYREG_INTC_VECT_MBASE+0x00)

; PWM_GateVoltage_PWMUDB
PWM_GateVoltage_PWMUDB_genblk1_ctrlreg__16BIT_CONTROL_AUX_CTL_REG EQU CYREG_B0_UDB06_07_ACTL
PWM_GateVoltage_PWMUDB_genblk1_ctrlreg__16BIT_CONTROL_CONTROL_REG EQU CYREG_B0_UDB06_07_CTL
PWM_GateVoltage_PWMUDB_genblk1_ctrlreg__16BIT_CONTROL_COUNT_REG EQU CYREG_B0_UDB06_07_CTL
PWM_GateVoltage_PWMUDB_genblk1_ctrlreg__16BIT_COUNT_CONTROL_REG EQU CYREG_B0_UDB06_07_CTL
PWM_GateVoltage_PWMUDB_genblk1_ctrlreg__16BIT_COUNT_COUNT_REG EQU CYREG_B0_UDB06_07_CTL
PWM_GateVoltage_PWMUDB_genblk1_ctrlreg__16BIT_MASK_MASK_REG EQU CYREG_B0_UDB06_07_MSK
PWM_GateVoltage_PWMUDB_genblk1_ctrlreg__16BIT_MASK_PERIOD_REG EQU CYREG_B0_UDB06_07_MSK
PWM_GateVoltage_PWMUDB_genblk1_ctrlreg__16BIT_PERIOD_MASK_REG EQU CYREG_B0_UDB06_07_MSK
PWM_GateVoltage_PWMUDB_genblk1_ctrlreg__16BIT_PERIOD_PERIOD_REG EQU CYREG_B0_UDB06_07_MSK
PWM_GateVoltage_PWMUDB_genblk1_ctrlreg__7__MASK EQU 0x80
PWM_GateVoltage_PWMUDB_genblk1_ctrlreg__7__POS EQU 7
PWM_GateVoltage_PWMUDB_genblk1_ctrlreg__CONTROL_AUX_CTL_REG EQU CYREG_B0_UDB06_ACTL
PWM_GateVoltage_PWMUDB_genblk1_ctrlreg__CONTROL_REG EQU CYREG_B0_UDB06_CTL
PWM_GateVoltage_PWMUDB_genblk1_ctrlreg__CONTROL_ST_REG EQU CYREG_B0_UDB06_ST_CTL
PWM_GateVoltage_PWMUDB_genblk1_ctrlreg__COUNT_REG EQU CYREG_B0_UDB06_CTL
PWM_GateVoltage_PWMUDB_genblk1_ctrlreg__COUNT_ST_REG EQU CYREG_B0_UDB06_ST_CTL
PWM_GateVoltage_PWMUDB_genblk1_ctrlreg__MASK EQU 0x80
PWM_GateVoltage_PWMUDB_genblk1_ctrlreg__MASK_CTL_AUX_CTL_REG EQU CYREG_B0_UDB06_MSK_ACTL
PWM_GateVoltage_PWMUDB_genblk1_ctrlreg__PER_CTL_AUX_CTL_REG EQU CYREG_B0_UDB06_MSK_ACTL
PWM_GateVoltage_PWMUDB_genblk1_ctrlreg__PERIOD_REG EQU CYREG_B0_UDB06_MSK
PWM_GateVoltage_PWMUDB_genblk8_stsreg__0__MASK EQU 0x01
PWM_GateVoltage_PWMUDB_genblk8_stsreg__0__POS EQU 0
PWM_GateVoltage_PWMUDB_genblk8_stsreg__16BIT_STATUS_AUX_CTL_REG EQU CYREG_B0_UDB06_07_ACTL
PWM_GateVoltage_PWMUDB_genblk8_stsreg__16BIT_STATUS_REG EQU CYREG_B0_UDB06_07_ST
PWM_GateVoltage_PWMUDB_genblk8_stsreg__2__MASK EQU 0x04
PWM_GateVoltage_PWMUDB_genblk8_stsreg__2__POS EQU 2
PWM_GateVoltage_PWMUDB_genblk8_stsreg__3__MASK EQU 0x08
PWM_GateVoltage_PWMUDB_genblk8_stsreg__3__POS EQU 3
PWM_GateVoltage_PWMUDB_genblk8_stsreg__MASK EQU 0x0D
PWM_GateVoltage_PWMUDB_genblk8_stsreg__MASK_REG EQU CYREG_B0_UDB06_MSK
PWM_GateVoltage_PWMUDB_genblk8_stsreg__MASK_ST_AUX_CTL_REG EQU CYREG_B0_UDB06_MSK_ACTL
PWM_GateVoltage_PWMUDB_genblk8_stsreg__PER_ST_AUX_CTL_REG EQU CYREG_B0_UDB06_MSK_ACTL
PWM_GateVoltage_PWMUDB_genblk8_stsreg__STATUS_AUX_CTL_REG EQU CYREG_B0_UDB06_ACTL
PWM_GateVoltage_PWMUDB_genblk8_stsreg__STATUS_CNT_REG EQU CYREG_B0_UDB06_ST_CTL
PWM_GateVoltage_PWMUDB_genblk8_stsreg__STATUS_CONTROL_REG EQU CYREG_B0_UDB06_ST_CTL
PWM_GateVoltage_PWMUDB_genblk8_stsreg__STATUS_REG EQU CYREG_B0_UDB06_ST
PWM_GateVoltage_PWMUDB_sP8_pwmdp_u0__16BIT_A0_REG EQU CYREG_B0_UDB06_07_A0
PWM_GateVoltage_PWMUDB_sP8_pwmdp_u0__16BIT_A1_REG EQU CYREG_B0_UDB06_07_A1
PWM_GateVoltage_PWMUDB_sP8_pwmdp_u0__16BIT_D0_REG EQU CYREG_B0_UDB06_07_D0
PWM_GateVoltage_PWMUDB_sP8_pwmdp_u0__16BIT_D1_REG EQU CYREG_B0_UDB06_07_D1
PWM_GateVoltage_PWMUDB_sP8_pwmdp_u0__16BIT_DP_AUX_CTL_REG EQU CYREG_B0_UDB06_07_ACTL
PWM_GateVoltage_PWMUDB_sP8_pwmdp_u0__16BIT_F0_REG EQU CYREG_B0_UDB06_07_F0
PWM_GateVoltage_PWMUDB_sP8_pwmdp_u0__16BIT_F1_REG EQU CYREG_B0_UDB06_07_F1
PWM_GateVoltage_PWMUDB_sP8_pwmdp_u0__A0_A1_REG EQU CYREG_B0_UDB06_A0_A1
PWM_GateVoltage_PWMUDB_sP8_pwmdp_u0__A0_REG EQU CYREG_B0_UDB06_A0
PWM_GateVoltage_PWMUDB_sP8_pwmdp_u0__A1_REG EQU CYREG_B0_UDB06_A1
PWM_GateVoltage_PWMUDB_sP8_pwmdp_u0__D0_D1_REG EQU CYREG_B0_UDB06_D0_D1
PWM_GateVoltage_PWMUDB_sP8_pwmdp_u0__D0_REG EQU CYREG_B0_UDB06_D0
PWM_GateVoltage_PWMUDB_sP8_pwmdp_u0__D1_REG EQU CYREG_B0_UDB06_D1
PWM_GateVoltage_PWMUDB_sP8_pwmdp_u0__DP_AUX_CTL_REG EQU CYREG_B0_UDB06_ACTL
PWM_GateVoltage_PWMUDB_sP8_pwmdp_u0__F0_F1_REG EQU CYREG_B0_UDB06_F0_F1
PWM_GateVoltage_PWMUDB_sP8_pwmdp_u0__F0_REG EQU CYREG_B0_UDB06_F0
PWM_GateVoltage_PWMUDB_sP8_pwmdp_u0__F1_REG EQU CYREG_B0_UDB06_F1
PWM_GateVoltage_PWMUDB_sP8_pwmdp_u0__MSK_DP_AUX_CTL_REG EQU CYREG_B0_UDB06_MSK_ACTL
PWM_GateVoltage_PWMUDB_sP8_pwmdp_u0__PER_DP_AUX_CTL_REG EQU CYREG_B0_UDB06_MSK_ACTL

; hallTickCounter_CounterUDB
hallTickCounter_CounterUDB_sC8_counterdp_u0__16BIT_A0_REG EQU CYREG_B0_UDB07_08_A0
hallTickCounter_CounterUDB_sC8_counterdp_u0__16BIT_A1_REG EQU CYREG_B0_UDB07_08_A1
hallTickCounter_CounterUDB_sC8_counterdp_u0__16BIT_D0_REG EQU CYREG_B0_UDB07_08_D0
hallTickCounter_CounterUDB_sC8_counterdp_u0__16BIT_D1_REG EQU CYREG_B0_UDB07_08_D1
hallTickCounter_CounterUDB_sC8_counterdp_u0__16BIT_DP_AUX_CTL_REG EQU CYREG_B0_UDB07_08_ACTL
hallTickCounter_CounterUDB_sC8_counterdp_u0__16BIT_F0_REG EQU CYREG_B0_UDB07_08_F0
hallTickCounter_CounterUDB_sC8_counterdp_u0__16BIT_F1_REG EQU CYREG_B0_UDB07_08_F1
hallTickCounter_CounterUDB_sC8_counterdp_u0__A0_A1_REG EQU CYREG_B0_UDB07_A0_A1
hallTickCounter_CounterUDB_sC8_counterdp_u0__A0_REG EQU CYREG_B0_UDB07_A0
hallTickCounter_CounterUDB_sC8_counterdp_u0__A1_REG EQU CYREG_B0_UDB07_A1
hallTickCounter_CounterUDB_sC8_counterdp_u0__D0_D1_REG EQU CYREG_B0_UDB07_D0_D1
hallTickCounter_CounterUDB_sC8_counterdp_u0__D0_REG EQU CYREG_B0_UDB07_D0
hallTickCounter_CounterUDB_sC8_counterdp_u0__D1_REG EQU CYREG_B0_UDB07_D1
hallTickCounter_CounterUDB_sC8_counterdp_u0__DP_AUX_CTL_REG EQU CYREG_B0_UDB07_ACTL
hallTickCounter_CounterUDB_sC8_counterdp_u0__F0_F1_REG EQU CYREG_B0_UDB07_F0_F1
hallTickCounter_CounterUDB_sC8_counterdp_u0__F0_REG EQU CYREG_B0_UDB07_F0
hallTickCounter_CounterUDB_sC8_counterdp_u0__F1_REG EQU CYREG_B0_UDB07_F1
hallTickCounter_CounterUDB_sCTRLReg_ctrlreg__16BIT_CONTROL_AUX_CTL_REG EQU CYREG_B1_UDB07_08_ACTL
hallTickCounter_CounterUDB_sCTRLReg_ctrlreg__16BIT_CONTROL_CONTROL_REG EQU CYREG_B1_UDB07_08_CTL
hallTickCounter_CounterUDB_sCTRLReg_ctrlreg__16BIT_CONTROL_COUNT_REG EQU CYREG_B1_UDB07_08_CTL
hallTickCounter_CounterUDB_sCTRLReg_ctrlreg__16BIT_COUNT_CONTROL_REG EQU CYREG_B1_UDB07_08_CTL
hallTickCounter_CounterUDB_sCTRLReg_ctrlreg__16BIT_COUNT_COUNT_REG EQU CYREG_B1_UDB07_08_CTL
hallTickCounter_CounterUDB_sCTRLReg_ctrlreg__16BIT_MASK_MASK_REG EQU CYREG_B1_UDB07_08_MSK
hallTickCounter_CounterUDB_sCTRLReg_ctrlreg__16BIT_MASK_PERIOD_REG EQU CYREG_B1_UDB07_08_MSK
hallTickCounter_CounterUDB_sCTRLReg_ctrlreg__16BIT_PERIOD_MASK_REG EQU CYREG_B1_UDB07_08_MSK
hallTickCounter_CounterUDB_sCTRLReg_ctrlreg__16BIT_PERIOD_PERIOD_REG EQU CYREG_B1_UDB07_08_MSK
hallTickCounter_CounterUDB_sCTRLReg_ctrlreg__7__MASK EQU 0x80
hallTickCounter_CounterUDB_sCTRLReg_ctrlreg__7__POS EQU 7
hallTickCounter_CounterUDB_sCTRLReg_ctrlreg__CONTROL_AUX_CTL_REG EQU CYREG_B1_UDB07_ACTL
hallTickCounter_CounterUDB_sCTRLReg_ctrlreg__CONTROL_REG EQU CYREG_B1_UDB07_CTL
hallTickCounter_CounterUDB_sCTRLReg_ctrlreg__CONTROL_ST_REG EQU CYREG_B1_UDB07_ST_CTL
hallTickCounter_CounterUDB_sCTRLReg_ctrlreg__COUNT_REG EQU CYREG_B1_UDB07_CTL
hallTickCounter_CounterUDB_sCTRLReg_ctrlreg__COUNT_ST_REG EQU CYREG_B1_UDB07_ST_CTL
hallTickCounter_CounterUDB_sCTRLReg_ctrlreg__MASK EQU 0x80
hallTickCounter_CounterUDB_sCTRLReg_ctrlreg__MASK_CTL_AUX_CTL_REG EQU CYREG_B1_UDB07_MSK_ACTL
hallTickCounter_CounterUDB_sCTRLReg_ctrlreg__PER_CTL_AUX_CTL_REG EQU CYREG_B1_UDB07_MSK_ACTL
hallTickCounter_CounterUDB_sCTRLReg_ctrlreg__PERIOD_REG EQU CYREG_B1_UDB07_MSK
hallTickCounter_CounterUDB_sSTSReg_stsreg__0__MASK EQU 0x01
hallTickCounter_CounterUDB_sSTSReg_stsreg__0__POS EQU 0
hallTickCounter_CounterUDB_sSTSReg_stsreg__1__MASK EQU 0x02
hallTickCounter_CounterUDB_sSTSReg_stsreg__1__POS EQU 1
hallTickCounter_CounterUDB_sSTSReg_stsreg__16BIT_STATUS_AUX_CTL_REG EQU CYREG_B1_UDB07_08_ACTL
hallTickCounter_CounterUDB_sSTSReg_stsreg__16BIT_STATUS_REG EQU CYREG_B1_UDB07_08_ST
hallTickCounter_CounterUDB_sSTSReg_stsreg__2__MASK EQU 0x04
hallTickCounter_CounterUDB_sSTSReg_stsreg__2__POS EQU 2
hallTickCounter_CounterUDB_sSTSReg_stsreg__5__MASK EQU 0x20
hallTickCounter_CounterUDB_sSTSReg_stsreg__5__POS EQU 5
hallTickCounter_CounterUDB_sSTSReg_stsreg__6__MASK EQU 0x40
hallTickCounter_CounterUDB_sSTSReg_stsreg__6__POS EQU 6
hallTickCounter_CounterUDB_sSTSReg_stsreg__MASK EQU 0x67
hallTickCounter_CounterUDB_sSTSReg_stsreg__MASK_REG EQU CYREG_B1_UDB07_MSK
hallTickCounter_CounterUDB_sSTSReg_stsreg__MASK_ST_AUX_CTL_REG EQU CYREG_B1_UDB07_MSK_ACTL
hallTickCounter_CounterUDB_sSTSReg_stsreg__PER_ST_AUX_CTL_REG EQU CYREG_B1_UDB07_MSK_ACTL
hallTickCounter_CounterUDB_sSTSReg_stsreg__STATUS_AUX_CTL_REG EQU CYREG_B1_UDB07_ACTL
hallTickCounter_CounterUDB_sSTSReg_stsreg__STATUS_CNT_REG EQU CYREG_B1_UDB07_ST_CTL
hallTickCounter_CounterUDB_sSTSReg_stsreg__STATUS_CONTROL_REG EQU CYREG_B1_UDB07_ST_CTL
hallTickCounter_CounterUDB_sSTSReg_stsreg__STATUS_REG EQU CYREG_B1_UDB07_ST

; hallEffectSensor
hallEffectSensor__0__INTTYPE EQU CYREG_PICU2_INTTYPE7
hallEffectSensor__0__MASK EQU 0x80
hallEffectSensor__0__PC EQU CYREG_PRT2_PC7
hallEffectSensor__0__PORT EQU 2
hallEffectSensor__0__SHIFT EQU 7
hallEffectSensor__AG EQU CYREG_PRT2_AG
hallEffectSensor__AMUX EQU CYREG_PRT2_AMUX
hallEffectSensor__BIE EQU CYREG_PRT2_BIE
hallEffectSensor__BIT_MASK EQU CYREG_PRT2_BIT_MASK
hallEffectSensor__BYP EQU CYREG_PRT2_BYP
hallEffectSensor__CTL EQU CYREG_PRT2_CTL
hallEffectSensor__DM0 EQU CYREG_PRT2_DM0
hallEffectSensor__DM1 EQU CYREG_PRT2_DM1
hallEffectSensor__DM2 EQU CYREG_PRT2_DM2
hallEffectSensor__DR EQU CYREG_PRT2_DR
hallEffectSensor__INP_DIS EQU CYREG_PRT2_INP_DIS
hallEffectSensor__INTTYPE_BASE EQU CYDEV_PICU_INTTYPE_PICU2_BASE
hallEffectSensor__LCD_COM_SEG EQU CYREG_PRT2_LCD_COM_SEG
hallEffectSensor__LCD_EN EQU CYREG_PRT2_LCD_EN
hallEffectSensor__MASK EQU 0x80
hallEffectSensor__PORT EQU 2
hallEffectSensor__PRT EQU CYREG_PRT2_PRT
hallEffectSensor__PRTDSI__CAPS_SEL EQU CYREG_PRT2_CAPS_SEL
hallEffectSensor__PRTDSI__DBL_SYNC_IN EQU CYREG_PRT2_DBL_SYNC_IN
hallEffectSensor__PRTDSI__OE_SEL0 EQU CYREG_PRT2_OE_SEL0
hallEffectSensor__PRTDSI__OE_SEL1 EQU CYREG_PRT2_OE_SEL1
hallEffectSensor__PRTDSI__OUT_SEL0 EQU CYREG_PRT2_OUT_SEL0
hallEffectSensor__PRTDSI__OUT_SEL1 EQU CYREG_PRT2_OUT_SEL1
hallEffectSensor__PRTDSI__SYNC_OUT EQU CYREG_PRT2_SYNC_OUT
hallEffectSensor__PS EQU CYREG_PRT2_PS
hallEffectSensor__SHIFT EQU 7
hallEffectSensor__SLW EQU CYREG_PRT2_SLW

; Miscellaneous
BCLK__BUS_CLK__HZ EQU 24000000
BCLK__BUS_CLK__KHZ EQU 24000
BCLK__BUS_CLK__MHZ EQU 24
CY_PROJECT_NAME LIT 'SpeedControl'
CY_VERSION LIT 'PSoC Creator  3.3 SP1'
CYDEV_CHIP_DIE_LEOPARD EQU 1
CYDEV_CHIP_DIE_PANTHER EQU 18
CYDEV_CHIP_DIE_PSOC4A EQU 10
CYDEV_CHIP_DIE_PSOC5LP EQU 17
CYDEV_CHIP_DIE_TMA4 EQU 2
CYDEV_CHIP_DIE_UNKNOWN EQU 0
CYDEV_CHIP_FAMILY_PSOC3 EQU 1
CYDEV_CHIP_FAMILY_PSOC4 EQU 2
CYDEV_CHIP_FAMILY_PSOC5 EQU 3
CYDEV_CHIP_FAMILY_UNKNOWN EQU 0
CYDEV_CHIP_FAMILY_USED EQU CYDEV_CHIP_FAMILY_PSOC3
CYDEV_CHIP_JTAG_ID EQU 0x1E028069
CYDEV_CHIP_MEMBER_3A EQU 1
CYDEV_CHIP_MEMBER_4A EQU 10
CYDEV_CHIP_MEMBER_4C EQU 15
CYDEV_CHIP_MEMBER_4D EQU 6
CYDEV_CHIP_MEMBER_4E EQU 4
CYDEV_CHIP_MEMBER_4F EQU 11
CYDEV_CHIP_MEMBER_4G EQU 2
CYDEV_CHIP_MEMBER_4H EQU 9
CYDEV_CHIP_MEMBER_4I EQU 14
CYDEV_CHIP_MEMBER_4J EQU 7
CYDEV_CHIP_MEMBER_4K EQU 8
CYDEV_CHIP_MEMBER_4L EQU 13
CYDEV_CHIP_MEMBER_4M EQU 12
CYDEV_CHIP_MEMBER_4N EQU 5
CYDEV_CHIP_MEMBER_4U EQU 3
CYDEV_CHIP_MEMBER_5A EQU 17
CYDEV_CHIP_MEMBER_5B EQU 16
CYDEV_CHIP_MEMBER_UNKNOWN EQU 0
CYDEV_CHIP_MEMBER_USED EQU CYDEV_CHIP_MEMBER_3A
CYDEV_CHIP_DIE_EXPECT EQU CYDEV_CHIP_MEMBER_USED
CYDEV_CHIP_DIE_ACTUAL EQU CYDEV_CHIP_DIE_EXPECT
CYDEV_CHIP_REV_LEOPARD_ES1 EQU 0
CYDEV_CHIP_REV_LEOPARD_ES2 EQU 1
CYDEV_CHIP_REV_LEOPARD_ES3 EQU 3
CYDEV_CHIP_REV_LEOPARD_PRODUCTION EQU 3
CYDEV_CHIP_REV_PANTHER_ES0 EQU 0
CYDEV_CHIP_REV_PANTHER_ES1 EQU 1
CYDEV_CHIP_REV_PANTHER_PRODUCTION EQU 1
CYDEV_CHIP_REV_PSOC4A_ES0 EQU 17
CYDEV_CHIP_REV_PSOC4A_PRODUCTION EQU 17
CYDEV_CHIP_REV_PSOC5LP_ES0 EQU 0
CYDEV_CHIP_REV_PSOC5LP_PRODUCTION EQU 0
CYDEV_CHIP_REV_TMA4_ES EQU 17
CYDEV_CHIP_REV_TMA4_ES2 EQU 33
CYDEV_CHIP_REV_TMA4_PRODUCTION EQU 17
CYDEV_CHIP_REVISION_3A_ES1 EQU 0
CYDEV_CHIP_REVISION_3A_ES2 EQU 1
CYDEV_CHIP_REVISION_3A_ES3 EQU 3
CYDEV_CHIP_REVISION_3A_PRODUCTION EQU 3
CYDEV_CHIP_REVISION_4A_ES0 EQU 17
CYDEV_CHIP_REVISION_4A_PRODUCTION EQU 17
CYDEV_CHIP_REVISION_4C_PRODUCTION EQU 0
CYDEV_CHIP_REVISION_4D_PRODUCTION EQU 0
CYDEV_CHIP_REVISION_4E_PRODUCTION EQU 0
CYDEV_CHIP_REVISION_4F_PRODUCTION EQU 0
CYDEV_CHIP_REVISION_4F_PRODUCTION_256DMA EQU 0
CYDEV_CHIP_REVISION_4F_PRODUCTION_256K EQU 0
CYDEV_CHIP_REVISION_4G_ES EQU 17
CYDEV_CHIP_REVISION_4G_ES2 EQU 33
CYDEV_CHIP_REVISION_4G_PRODUCTION EQU 17
CYDEV_CHIP_REVISION_4H_PRODUCTION EQU 0
CYDEV_CHIP_REVISION_4I_PRODUCTION EQU 0
CYDEV_CHIP_REVISION_4J_PRODUCTION EQU 0
CYDEV_CHIP_REVISION_4K_PRODUCTION EQU 0
CYDEV_CHIP_REVISION_4L_PRODUCTION EQU 0
CYDEV_CHIP_REVISION_4M_PRODUCTION EQU 0
CYDEV_CHIP_REVISION_4N_PRODUCTION EQU 0
CYDEV_CHIP_REVISION_4U_PRODUCTION EQU 0
CYDEV_CHIP_REVISION_5A_ES0 EQU 0
CYDEV_CHIP_REVISION_5A_ES1 EQU 1
CYDEV_CHIP_REVISION_5A_PRODUCTION EQU 1
CYDEV_CHIP_REVISION_5B_ES0 EQU 0
CYDEV_CHIP_REVISION_5B_PRODUCTION EQU 0
CYDEV_CHIP_REVISION_USED EQU CYDEV_CHIP_REVISION_3A_PRODUCTION
CYDEV_CHIP_REV_EXPECT EQU CYDEV_CHIP_REVISION_USED
CYDEV_CONFIG_FASTBOOT_ENABLED EQU 1
CYDEV_CONFIG_UNUSED_IO_AllowButWarn EQU 0
CYDEV_CONFIG_UNUSED_IO EQU CYDEV_CONFIG_UNUSED_IO_AllowButWarn
CYDEV_CONFIG_UNUSED_IO_AllowWithInfo EQU 1
CYDEV_CONFIG_UNUSED_IO_Disallowed EQU 2
CYDEV_CONFIGURATION_CLEAR_SRAM EQU 1
CYDEV_CONFIGURATION_COMPRESSED EQU 1
CYDEV_CONFIGURATION_DMA EQU 0
CYDEV_CONFIGURATION_ECC EQU 1
CYDEV_CONFIGURATION_IMOENABLED EQU CYDEV_CONFIG_FASTBOOT_ENABLED
CYDEV_CONFIGURATION_MODE_COMPRESSED EQU 0
CYDEV_CONFIGURATION_MODE EQU CYDEV_CONFIGURATION_MODE_COMPRESSED
CYDEV_CONFIGURATION_MODE_DMA EQU 2
CYDEV_CONFIGURATION_MODE_UNCOMPRESSED EQU 1
CYDEV_DEBUG_ENABLE_MASK EQU 0x01
CYDEV_DEBUG_ENABLE_REGISTER EQU CYREG_MLOGIC_DEBUG
CYDEV_DEBUGGING_DPS_Disable EQU 3
CYDEV_DEBUGGING_DPS_JTAG_4 EQU 1
CYDEV_DEBUGGING_DPS_JTAG_5 EQU 0
CYDEV_DEBUGGING_DPS_SWD EQU 2
CYDEV_DEBUGGING_DPS_SWD_SWV EQU 6
CYDEV_DEBUGGING_DPS EQU CYDEV_DEBUGGING_DPS_SWD_SWV
CYDEV_DEBUGGING_ENABLE EQU 1
CYDEV_DEBUGGING_XRES EQU 0
CYDEV_DMA_CHANNELS_AVAILABLE EQU 24
CYDEV_ECC_ENABLE EQU 0
CYDEV_INSTRUCT_CACHE_ENABLED EQU 1
CYDEV_INTR_RISING EQU 0x00000001
CYDEV_IS_EXPORTING_CODE EQU 0
CYDEV_IS_IMPORTING_CODE EQU 0
CYDEV_PROJ_TYPE EQU 0
CYDEV_PROJ_TYPE_BOOTLOADER EQU 1
CYDEV_PROJ_TYPE_LAUNCHER EQU 5
CYDEV_PROJ_TYPE_LOADABLE EQU 2
CYDEV_PROJ_TYPE_LOADABLEANDBOOTLOADER EQU 4
CYDEV_PROJ_TYPE_MULTIAPPBOOTLOADER EQU 3
CYDEV_PROJ_TYPE_STANDARD EQU 0
CYDEV_PROTECTION_ENABLE EQU 0
CYDEV_VARIABLE_VDDA EQU 0
CYDEV_VDDA LIT '5.0'
CYDEV_VDDA_MV EQU 5000
CYDEV_VDDD LIT '5.0'
CYDEV_VDDD_MV EQU 5000
CYDEV_VDDIO0 LIT '5.0'
CYDEV_VDDIO0_MV EQU 5000
CYDEV_VDDIO1 LIT '5.0'
CYDEV_VDDIO1_MV EQU 5000
CYDEV_VDDIO2 LIT '5.0'
CYDEV_VDDIO2_MV EQU 5000
CYDEV_VDDIO3 LIT '5.0'
CYDEV_VDDIO3_MV EQU 5000
CYDEV_VIO0 LIT '5.0'
CYDEV_VIO0_MV EQU 5000
CYDEV_VIO1 LIT '5.0'
CYDEV_VIO1_MV EQU 5000
CYDEV_VIO2 LIT '5.0'
CYDEV_VIO2_MV EQU 5000
CYDEV_VIO3 LIT '5.0'
CYDEV_VIO3_MV EQU 5000
CYIPBLOCK_DP8051_VERSION EQU 0
CYIPBLOCK_P3_ANAIF_VERSION EQU 0
CYIPBLOCK_P3_CAN_VERSION EQU 0
CYIPBLOCK_P3_CAPSENSE_VERSION EQU 0
CYIPBLOCK_P3_COMP_VERSION EQU 0
CYIPBLOCK_P3_DECIMATOR_VERSION EQU 0
CYIPBLOCK_P3_DFB_VERSION EQU 0
CYIPBLOCK_P3_DMA_VERSION EQU 0
CYIPBLOCK_P3_DRQ_VERSION EQU 0
CYIPBLOCK_P3_DSM_VERSION EQU 0
CYIPBLOCK_P3_EMIF_VERSION EQU 0
CYIPBLOCK_P3_I2C_VERSION EQU 0
CYIPBLOCK_P3_LCD_VERSION EQU 0
CYIPBLOCK_P3_LPF_VERSION EQU 0
CYIPBLOCK_P3_OPAMP_VERSION EQU 0
CYIPBLOCK_P3_PM_VERSION EQU 0
CYIPBLOCK_P3_SCCT_VERSION EQU 0
CYIPBLOCK_P3_TIMER_VERSION EQU 0
CYIPBLOCK_P3_USB_VERSION EQU 0
CYIPBLOCK_P3_VIDAC_VERSION EQU 0
CYIPBLOCK_P3_VREF_VERSION EQU 0
CYIPBLOCK_S8_GPIO_VERSION EQU 0
CYIPBLOCK_S8_IRQ_VERSION EQU 0
CYIPBLOCK_S8_SIO_VERSION EQU 0
CYIPBLOCK_S8_UDB_VERSION EQU 0
DMA_CHANNELS_USED__MASK0 EQU 0x00000000
CYDEV_BOOTLOADER_ENABLE EQU 0

#endif /* INCLUDED_CYFITTERKEIL_INC */
